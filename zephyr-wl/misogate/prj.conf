## CMakeLists.txt
```
cmake_minimum_required(VERSION 3.20.0)

# Point CMake at Zephyr
find_package(Zephyr REQUIRED HINTS $ENV{ZEPHYR_BASE})
project(my_app)

# Your source files
target_sources(app PRIVATE
  src/main.c
  src/packet.c
  src/crypto_min.c
  src/siphash.c
)
```

## prj.conf
```kconfig
# --- Console / logging ---
CONFIG_SERIAL=y
CONFIG_CONSOLE=y
CONFIG_UART_CONSOLE=y
CONFIG_PRINTK=y
CONFIG_LOG=y

# --- GPIO for LED ---
CONFIG_GPIO=y

# --- LoRa / radio support ---
CONFIG_LORA=y
CONFIG_LORA_LOG_LEVEL_INF=y
CONFIG_LOG_MODE_IMMEDIATE=y
# CONFIG_LORA_SHELL=y    # you can turn this on later to poke LoRa from a shell

# RX needs a bigger stack too
CONFIG_MAIN_STACK_SIZE=4096
```

## src/main.c
```c
#include <stdint.h>
#include <stdlib.h> // abs()
#include <string.h>
#include <zephyr/device.h>
#include <zephyr/drivers/lora.h>
#include <zephyr/kernel.h>
#include <zephyr/logging/log.h>

#include "packet.h"

LOG_MODULE_REGISTER(misogate, LOG_LEVEL_INF);

int packet_parse_secure_frame_encmac(const uint8_t *in, size_t in_len,
                                     struct sensor_frame *out);

void main(void) {
  const struct device *lora = DEVICE_DT_GET(DT_ALIAS(lora0));
  if (!device_is_ready(lora)) {
    LOG_ERR("LoRa device not ready");
    return;
  }

  struct lora_modem_config cfg = {
      .frequency = 915000000UL,
      .bandwidth = BW_125_KHZ,
      .datarate = SF_7,
      .coding_rate = CR_4_5,
      .preamble_len = 8,
      .tx_power = 10,
      .tx = false,
      .iq_inverted = false,
      .public_network = true,
  };
  if (lora_config(lora, &cfg) < 0) {
    LOG_ERR("lora_config failed");
    return;
  }

  LOG_INF("misogate: RX (Encrypt-then-MAC)");

  uint32_t rx_ok = 0;
  while (1) {
    uint8_t buf[64];
    int16_t rssi, snr;
    int len = lora_recv(lora, buf, sizeof(buf), K_SECONDS(10), &rssi, &snr);

    if (len > 0) {
      struct sensor_frame f;
      if (packet_parse_secure_frame_encmac(buf, len, &f) == 0) {
        rx_ok++;
        int16_t t_abs = abs(f.temp_c_times10 % 10);
        LOG_INF("SECURE PKT rx_ok=%u node=%u tx_seq=%u X=%u m-uT Y=%u m-uT "
                "Z=%u m-uT "
                "T=%d.%d C RSSI=%d dBm SNR=%d dB len=%d",
                (unsigned)rx_ok, (unsigned)f.node_id, (unsigned)f.tx_seq,
                (unsigned)f.x_uT_milli, (unsigned)f.y_uT_milli,
                (unsigned)f.z_uT_milli, f.temp_c_times10 / 10, t_abs, rssi, snr,
                len);
        /* TODO: emit JSON over UART to Nordic here */
      } else {
        LOG_WRN("SECURITY DROP len=%d RSSI=%d SNR=%d", len, rssi, snr);
      }
    } else {
      LOG_INF("misogate: waiting...");
    }
  }
}
```

## src/crypto_min.c
```c
#include "crypto_min.h"
#include "siphash.h"
#include <string.h>

static void sip_to_16(uint8_t out16[16],
                      const uint8_t key[16],
                      const uint8_t *label, size_t lab_len)
{
    uint8_t tag[8];
    siphash24(tag, label, lab_len, key);
    memcpy(out16, tag, 8);

    uint8_t lab2[32];
    size_t n = 0;
    for (; n < lab_len && n < sizeof(lab2)-1; ++n) lab2[n] = label[n];
    lab2[n++] = 0xA5; // domain separator
    siphash24(tag, lab2, n, key);
    memcpy(out16 + 8, tag, 8);
}

void kdf_split_keys(const uint8_t k_master[16], uint8_t node_id,
                    uint8_t K_enc_out[16], uint8_t K_mac_out[16])
{
    uint8_t labelE[6] = {'E','N','C', node_id, 0x00, 0x01};
    uint8_t labelM[6] = {'M','A','C', node_id, 0x00, 0x01};
    sip_to_16(K_enc_out, k_master, labelE, sizeof(labelE));
    sip_to_16(K_mac_out, k_master, labelM, sizeof(labelM));
}

void keystream_from_seq(uint8_t *out, size_t n,
                        const uint8_t K_enc[16], uint32_t tx_seq)
{
    /* Generate 8B blocks: SipHash(K_enc, 'S' || tx_seq || block#) */
    uint8_t in[1 + 4 + 4];
    in[0] = 'S';
    in[1] = (uint8_t)(tx_seq >> 0);
    in[2] = (uint8_t)(tx_seq >> 8);
    in[3] = (uint8_t)(tx_seq >> 16);
    in[4] = (uint8_t)(tx_seq >> 24);

    uint8_t tag[8];
    uint32_t block = 0;
    size_t produced = 0;
    while (produced < n) {
        in[5] = (uint8_t)(block >> 0);
        in[6] = (uint8_t)(block >> 8);
        in[7] = (uint8_t)(block >> 16);
        in[8] = (uint8_t)(block >> 24);
        siphash24(tag, in, sizeof(in), K_enc);
        size_t take = (n - produced < 8) ? (n - produced) : 8;
        for (size_t i = 0; i < take; ++i) out[produced + i] = tag[i];
        produced += take;
        block++;
    }
}
```

## src/packet.c
```c
#include "packet.h"
#include "crypto_min.h"
#include "siphash.h"
#include <stdlib.h>
#include <string.h>

/* Same per-node master key as node */
static const uint8_t NODE_MASTER_KEY[16] = {0x4d, 0x69, 0x73, 0x6f, 0x4b, 0x65,
                                            0x79, 0x21, 0x10, 0x22, 0x33, 0x44,
                                            0x55, 0x66, 0x77, 0x88};

static uint32_t last_seq_seen[256];

int packet_parse_secure_frame_encmac(const uint8_t *in, size_t in_len,
                                     struct sensor_frame *out) {
  if (in_len < SECURE_FRAME_LEN)
    return -1;

  uint8_t node_id = in[0];
  uint32_t tx_seq = (uint32_t)in[1] | ((uint32_t)in[2] << 8) |
                    ((uint32_t)in[3] << 16) | ((uint32_t)in[4] << 24);

  const uint8_t *ct = &in[5];
  const uint8_t *tag = &in[5 + SENSOR_PLAINTEXT_LEN];

  uint8_t K_enc[16], K_mac[16];
  kdf_split_keys(NODE_MASTER_KEY, node_id, K_enc, K_mac);

  // MAC check first (Encrypt-then-MAC)
  uint8_t mac_input[1 + 4 + SENSOR_PLAINTEXT_LEN];
  mac_input[0] = node_id;
  mac_input[1] = in[1];
  mac_input[2] = in[2];
  mac_input[3] = in[3];
  mac_input[4] = in[4];
  memcpy(&mac_input[5], ct, SENSOR_PLAINTEXT_LEN);

  uint8_t calc[TAG_LEN];
  siphash24(calc, mac_input, sizeof(mac_input), K_mac);
  if (memcmp(calc, tag, TAG_LEN) != 0)
    return -1;

  // Replay protection per node
  if (tx_seq <= last_seq_seen[node_id])
    return -1;
  last_seq_seen[node_id] = tx_seq;

  // Decrypt

  uint8_t ks[SENSOR_PLAINTEXT_LEN], pt[SENSOR_PLAINTEXT_LEN];
  keystream_from_seq(ks, sizeof(ks), K_enc, tx_seq);
  for (size_t i = 0; i < SENSOR_PLAINTEXT_LEN; ++i)
    pt[i] = ct[i] ^ ks[i];

  out->node_id = node_id;
  out->tx_seq = tx_seq;
  return unpack_sensor_payload(pt, out);
}
```

## src/packet.h
```c
#pragma once
#include <stddef.h>
#include <stdint.h>

/* Frame & payload layout (unchanged size: 28 bytes) */
#define MSG_TYPE_SENSOR 0x01
#define SENSOR_PLAINTEXT_LEN 15
#define TAG_LEN 8
#define SECURE_FRAME_LEN (1 + 4 + SENSOR_PLAINTEXT_LEN + TAG_LEN)

/* Sensor struct used at the app edges */
struct sensor_frame {
  uint8_t node_id;
  uint32_t tx_seq;
  uint32_t x_uT_milli;
  uint32_t y_uT_milli;
  uint32_t z_uT_milli;
  int16_t temp_c_times10;
};

/* --- helpers to pack/unpack 15B sensor payload --- */
static inline void pack_sensor_payload(uint8_t *buf,
                                       const struct sensor_frame *m) {
  buf[0] = MSG_TYPE_SENSOR;
  buf[1] = (uint8_t)(m->x_uT_milli >> 0);
  buf[2] = (uint8_t)(m->x_uT_milli >> 8);
  buf[3] = (uint8_t)(m->x_uT_milli >> 16);
  buf[4] = (uint8_t)(m->x_uT_milli >> 24);

  buf[5] = (uint8_t)(m->y_uT_milli >> 0);
  buf[6] = (uint8_t)(m->y_uT_milli >> 8);
  buf[7] = (uint8_t)(m->y_uT_milli >> 16);
  buf[8] = (uint8_t)(m->y_uT_milli >> 24);

  buf[9] = (uint8_t)(m->z_uT_milli >> 0);
  buf[10] = (uint8_t)(m->z_uT_milli >> 8);
  buf[11] = (uint8_t)(m->z_uT_milli >> 16);
  buf[12] = (uint8_t)(m->z_uT_milli >> 24);

  uint16_t t = (uint16_t)m->temp_c_times10;
  buf[13] = (uint8_t)(t >> 0);
  buf[14] = (uint8_t)(t >> 8);
}

static inline int unpack_sensor_payload(const uint8_t *p,
                                        struct sensor_frame *out) {
  if (p[0] != MSG_TYPE_SENSOR)
    return -1;
  out->x_uT_milli = (uint32_t)p[1] | ((uint32_t)p[2] << 8) |
                    ((uint32_t)p[3] << 16) | ((uint32_t)p[4] << 24);
  out->y_uT_milli = (uint32_t)p[5] | ((uint32_t)p[6] << 8) |
                    ((uint32_t)p[7] << 16) | ((uint32_t)p[8] << 24);
  out->z_uT_milli = (uint32_t)p[9] | ((uint32_t)p[10] << 8) |
                    ((uint32_t)p[11] << 16) | ((uint32_t)p[12] << 24);
  out->temp_c_times10 = (int16_t)((uint16_t)p[13] | ((uint16_t)p[14] << 8));
  return 0;
}
```

## src/siphash.c
```c
#include "siphash.h"

static inline uint64_t U8TO64_LE(const uint8_t *p){
    return ((uint64_t)p[0])       | ((uint64_t)p[1] << 8)  |
           ((uint64_t)p[2] << 16) | ((uint64_t)p[3] << 24) |
           ((uint64_t)p[4] << 32) | ((uint64_t)p[5] << 40) |
           ((uint64_t)p[6] << 48) | ((uint64_t)p[7] << 56);
}
static inline uint64_t ROTL64(uint64_t x, int b){ return (x << b) | (x >> (64 - b)); }
static inline void sipround(uint64_t *v0, uint64_t *v1, uint64_t *v2, uint64_t *v3){
    *v0 += *v1; *v1 = ROTL64(*v1,13) ^ *v0; *v0 = ROTL64(*v0,32);
    *v2 += *v3; *v3 = ROTL64(*v3,16) ^ *v2;
    *v0 += *v3; *v3 = ROTL64(*v3,21) ^ *v0;
    *v2 += *v1; *v1 = ROTL64(*v1,17) ^ *v2; *v2 = ROTL64(*v2,32);
}

void siphash24(uint8_t out[8], const uint8_t *m, size_t len, const uint8_t key[16]){
    uint64_t k0 = U8TO64_LE(key + 0);
    uint64_t k1 = U8TO64_LE(key + 8);
    uint64_t v0 = 0x736f6d6570736575ULL ^ k0;
    uint64_t v1 = 0x646f72616e646f6dULL ^ k1;
    uint64_t v2 = 0x6c7967656e657261ULL ^ k0;
    uint64_t v3 = 0x7465646279746573ULL ^ k1;

    const uint8_t *end = m + (len & ~((size_t)7));
    int left = (int)(len & 7);

    for (const uint8_t *p = m; p != end; p += 8){
        uint64_t mi = U8TO64_LE(p);
        v3 ^= mi; sipround(&v0,&v1,&v2,&v3); sipround(&v0,&v1,&v2,&v3); v0 ^= mi;
    }

    uint64_t b = ((uint64_t)len) << 56;
    switch (left) { /* fallthroughs intentional */
        case 7: b |= ((uint64_t)m[len - 7]) << 48;
        case 6: b |= ((uint64_t)m[len - 6]) << 40;
        case 5: b |= ((uint64_t)m[len - 5]) << 32;
        case 4: b |= ((uint64_t)m[len - 4]) << 24;
        case 3: b |= ((uint64_t)m[len - 3]) << 16;
        case 2: b |= ((uint64_t)m[len - 2]) << 8;
        case 1: b |= ((uint64_t)m[len - 1]);
        default: break;
    }

    v3 ^= b; sipround(&v0,&v1,&v2,&v3); sipround(&v0,&v1,&v2,&v3); v0 ^= b;
    v2 ^= 0xff;
    sipround(&v0,&v1,&v2,&v3); sipround(&v0,&v1,&v2,&v3);
    sipround(&v0,&v1,&v2,&v3); sipround(&v0,&v1,&v2,&v3);
    uint64_t tag = v0 ^ v1 ^ v2 ^ v3;

    out[0]=(uint8_t)(tag>>0);  out[1]=(uint8_t)(tag>>8);
    out[2]=(uint8_t)(tag>>16); out[3]=(uint8_t)(tag>>24);
    out[4]=(uint8_t)(tag>>32); out[5]=(uint8_t)(tag>>40);
    out[6]=(uint8_t)(tag>>48); out[7]=(uint8_t)(tag>>56);
}
```
