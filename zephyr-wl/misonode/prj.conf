## CMakeLists.txt
```
cmake_minimum_required(VERSION 3.20.0)

# Point CMake at Zephyr
find_package(Zephyr REQUIRED HINTS $ENV{ZEPHYR_BASE})
project(my_app)

# Your source files
target_sources(app PRIVATE
  src/main.c
  src/mag.c
  src/packet.c
  src/crypto_min.c
  src/siphash.c
)
```

## prj.conf
```kconfig
# --- Console / logging ---
CONFIG_SERIAL=y
CONFIG_CONSOLE=y
CONFIG_UART_CONSOLE=y
CONFIG_PRINTK=y
CONFIG_LOG=y

# --- GPIO for LED ---
CONFIG_GPIO=y

# --- LoRa / radio support ---
CONFIG_LORA=y          # enable LoRa API layer
CONFIG_LORA_LOG_LEVEL_INF=y
CONFIG_LOG_MODE_IMMEDIATE=y
# optional: CONFIG_LORA_SHELL=y if you want shell cmds later

# Thread stack size safety for Zephyr APIs
CONFIG_MAIN_STACK_SIZE=2048
```

## src/main.c
```c
#include <stdint.h>
#include <string.h>
#include <zephyr/device.h>
#include <zephyr/drivers/lora.h>
#include <zephyr/kernel.h>
#include <zephyr/logging/log.h>

#include "mag.h"
#include "packet.h"

LOG_MODULE_REGISTER(misonode, LOG_LEVEL_INF);

#define NODE_ID 0x01

size_t packet_build_secure_frame_encmac(uint8_t node_id, uint32_t tx_seq,
                                        const struct mag_sample *m_in,
                                        uint8_t *out, size_t out_max);

void main(void) {
  const struct device *lora = DEVICE_DT_GET(DT_ALIAS(lora0));
  if (!device_is_ready(lora)) {
    LOG_ERR("LoRa device not ready");
    return;
  }

  struct lora_modem_config cfg = {
      .frequency = 915000000UL,
      .bandwidth = BW_125_KHZ,
      .datarate = SF_7,
      .coding_rate = CR_4_5,
      .preamble_len = 8,
      .tx_power = 10,
      .tx = true,
      .iq_inverted = false,
      .public_network = true,
  };
  if (lora_config(lora, &cfg) < 0) {
    LOG_ERR("lora_config failed");
    return;
  }

  LOG_INF("misonode: TX (Encrypt-then-MAC, SipHash + stream)");

  uint32_t tx_seq = 0;
  while (1) {
    struct mag_sample m;
    mag_read(&m);

    uint8_t frame[SECURE_FRAME_LEN];
    size_t len = packet_build_secure_frame_encmac(NODE_ID, tx_seq, &m, frame,
                                                  sizeof(frame));
    if (len == 0) {
      LOG_ERR("build frame failed");
    } else {
      int rc = lora_send(lora, frame, len);
      if (rc < 0)
        LOG_ERR("lora_send err %d", rc);
      else
        LOG_INF("sent node=%u seq=%u len=%u", NODE_ID, tx_seq, (unsigned)len);
      tx_seq++;
    }
    k_sleep(K_SECONDS(5));
  }
}
```

## src/crypto_min.h
```c
#pragma once
#include <stdint.h>
#include <stddef.h>

/* Derive ENC and MAC subkeys from a 16-byte per-node master key */
void kdf_split_keys(const uint8_t k_master[16], uint8_t node_id,
                    uint8_t K_enc_out[16], uint8_t K_mac_out[16]);

/* Build keystream from K_enc and tx_seq (nonce) */
void keystream_from_seq(uint8_t *out, size_t n,
                        const uint8_t K_enc[16], uint32_t tx_seq);
```

## src/mag.c
```c
#include "mag.h"

void mag_read(struct mag_sample *out)
{
    // Pretend raw 18-bit values straight from sensor:
    // Pick numbers in range ~0..16384 for ~±0.5 G-ish.
    out->raw_x_counts = 8000;
    out->raw_y_counts = 1000;
    out->raw_z_counts = 7000;

    // Convert fake raw counts -> microtesla *1000.
    // Math we'll actually do in real code later:
    // 1 count ≈ 0.006103515625 µT (from datasheet scaling logic)
    // So uT = counts * 0.006103515625
    // uT*1000 = counts * 6.103515625
    out->x_uT_milli = (uint32_t)(out->raw_x_counts * 6.1035f); // ~48828
    out->y_uT_milli = (uint32_t)(out->raw_y_counts * 6.1035f); // ~6103
    out->z_uT_milli = (uint32_t)(out->raw_z_counts * 6.1035f); // ~42724

    // Fake temperature: 24.5 C
    out->temp_c_times10 = 245;
}
```

## src/mag.h
```c
#pragma once
#include <stdint.h>

struct mag_sample {
    // Magnetic field in microtesla *1000 (so 42.000 µT => 42000)
    uint32_t x_uT_milli;
    uint32_t y_uT_milli;
    uint32_t z_uT_milli;

    // Temperature in degC *10 (so 24.5 C => 245)
    int16_t  temp_c_times10;

    // (Optional future: raw 18-bit counts if we ever want to debug calibration)
    uint32_t raw_x_counts;
    uint32_t raw_y_counts;
    uint32_t raw_z_counts;
};

// Called by main.
// Fills out with "realistic" data for now.
// Later we replace the internals with actual I2C to MMC5983MA.
void mag_read(struct mag_sample *out);
```

## src/packet.c
```c
// misonode/src/packet.c
#include "packet.h"
#include "crypto_min.h"
#include "mag.h"
#include "siphash.h"
#include <string.h>

/* Per-node 128-bit master key (hardcode for class; store per-node) */
static const uint8_t NODE_MASTER_KEY[16] = {0x4d, 0x69, 0x73, 0x6f, 0x4b, 0x65,
                                            0x79, 0x21, 0x10, 0x22, 0x33, 0x44,
                                            0x55, 0x66, 0x77, 0x88};

size_t packet_build_secure_frame_encmac(uint8_t node_id, uint32_t tx_seq,
                                        const struct mag_sample *m_in,
                                        uint8_t *out, size_t out_max) {
  if (out_max < SECURE_FRAME_LEN)
    return 0;

  // Header
  out[0] = node_id;
  out[1] = (uint8_t)(tx_seq >> 0);
  out[2] = (uint8_t)(tx_seq >> 8);
  out[3] = (uint8_t)(tx_seq >> 16);
  out[4] = (uint8_t)(tx_seq >> 24);

  // Build payload from sample
  struct sensor_frame s = {.node_id = node_id,
                           .tx_seq = tx_seq,
                           .x_uT_milli = m_in->x_uT_milli,
                           .y_uT_milli = m_in->y_uT_milli,
                           .z_uT_milli = m_in->z_uT_milli,
                           .temp_c_times10 = m_in->temp_c_times10};
  uint8_t pt[SENSOR_PLAINTEXT_LEN];
  pack_sensor_payload(pt, &s);

  // Derive subkeys; encrypt (XOR keystream); MAC over AAD||ciphertext
  uint8_t K_enc[16], K_mac[16], ks[SENSOR_PLAINTEXT_LEN];
  kdf_split_keys(NODE_MASTER_KEY, node_id, K_enc, K_mac);
  keystream_from_seq(ks, sizeof(ks), K_enc, tx_seq);

  uint8_t *ct = &out[5];
  for (size_t i = 0; i < SENSOR_PLAINTEXT_LEN; ++i)
    ct[i] = pt[i] ^ ks[i];

  uint8_t mac_input[1 + 4 + SENSOR_PLAINTEXT_LEN];
  mac_input[0] = node_id;
  mac_input[1] = out[1];
  mac_input[2] = out[2];
  mac_input[3] = out[3];
  mac_input[4] = out[4];
  memcpy(&mac_input[5], ct, SENSOR_PLAINTEXT_LEN);

  uint8_t tag[TAG_LEN];
  siphash24(tag, mac_input, sizeof(mac_input), K_mac);

  memcpy(&out[5 + SENSOR_PLAINTEXT_LEN], tag, TAG_LEN);
  return SECURE_FRAME_LEN;
}
```

## src/packet.h
```c
#pragma once
#include <stdint.h>
#include <stddef.h>

/* Frame & payload layout (unchanged size: 28 bytes) */
#define MSG_TYPE_SENSOR         0x01
#define SENSOR_PLAINTEXT_LEN    15
#define TAG_LEN                 8
#define SECURE_FRAME_LEN        (1 + 4 + SENSOR_PLAINTEXT_LEN + TAG_LEN)

/* Sensor struct used at the app edges */
struct sensor_frame {
    uint8_t  node_id;
    uint32_t tx_seq;
    uint32_t x_uT_milli;
    uint32_t y_uT_milli;
    uint32_t z_uT_milli;
    int16_t  temp_c_times10;
};

/* --- helpers to pack/unpack 15B sensor payload --- */
static inline void pack_sensor_payload(uint8_t *buf, const struct sensor_frame *m) {
    buf[0] = MSG_TYPE_SENSOR;
    buf[1] = (uint8_t)(m->x_uT_milli >> 0);
    buf[2] = (uint8_t)(m->x_uT_milli >> 8);
    buf[3] = (uint8_t)(m->x_uT_milli >> 16);
    buf[4] = (uint8_t)(m->x_uT_milli >> 24);

    buf[5] = (uint8_t)(m->y_uT_milli >> 0);
    buf[6] = (uint8_t)(m->y_uT_milli >> 8);
    buf[7] = (uint8_t)(m->y_uT_milli >> 16);
    buf[8] = (uint8_t)(m->y_uT_milli >> 24);

    buf[9]  = (uint8_t)(m->z_uT_milli >> 0);
    buf[10] = (uint8_t)(m->z_uT_milli >> 8);
    buf[11] = (uint8_t)(m->z_uT_milli >> 16);
    buf[12] = (uint8_t)(m->z_uT_milli >> 24);

    uint16_t t = (uint16_t)m->temp_c_times10;
    buf[13] = (uint8_t)(t >> 0);
    buf[14] = (uint8_t)(t >> 8);
}

static inline int unpack_sensor_payload(const uint8_t *p, struct sensor_frame *out) {
    if (p[0] != MSG_TYPE_SENSOR) return -1;
    out->x_uT_milli     = (uint32_t)p[1] | ((uint32_t)p[2]<<8) | ((uint32_t)p[3]<<16) | ((uint32_t)p[4]<<24);
    out->y_uT_milli     = (uint32_t)p[5] | ((uint32_t)p[6]<<8) | ((uint32_t)p[7]<<16) | ((uint32_t)p[8]<<24);
    out->z_uT_milli     = (uint32_t)p[9] | ((uint32_t)p[10]<<8)| ((uint32_t)p[11]<<16)| ((uint32_t)p[12]<<24);
    out->temp_c_times10 = (int16_t)((uint16_t)p[13] | ((uint16_t)p[14]<<8));
    return 0;
}
```

## src/siphash.c
```c
#include "siphash.h"

static inline uint64_t U8TO64_LE(const uint8_t *p) {
  return ((uint64_t)p[0]) | ((uint64_t)p[1] << 8) | ((uint64_t)p[2] << 16) |
         ((uint64_t)p[3] << 24) | ((uint64_t)p[4] << 32) |
         ((uint64_t)p[5] << 40) | ((uint64_t)p[6] << 48) |
         ((uint64_t)p[7] << 56);
}
static inline uint64_t ROTL64(uint64_t x, int b) {
  return (x << b) | (x >> (64 - b));
}
static inline void sipround(uint64_t *v0, uint64_t *v1, uint64_t *v2,
                            uint64_t *v3) {
  *v0 += *v1;
  *v1 = ROTL64(*v1, 13) ^ *v0;
  *v0 = ROTL64(*v0, 32);
  *v2 += *v3;
  *v3 = ROTL64(*v3, 16) ^ *v2;
  *v0 += *v3;
  *v3 = ROTL64(*v3, 21) ^ *v0;
  *v2 += *v1;
  *v1 = ROTL64(*v1, 17) ^ *v2;
  *v2 = ROTL64(*v2, 32);
}

void siphash24(uint8_t out[8], const uint8_t *m, size_t len,
               const uint8_t key[16]) {
  uint64_t k0 = U8TO64_LE(key + 0);
  uint64_t k1 = U8TO64_LE(key + 8);
  uint64_t v0 = 0x736f6d6570736575ULL ^ k0;
  uint64_t v1 = 0x646f72616e646f6dULL ^ k1;
  uint64_t v2 = 0x6c7967656e657261ULL ^ k0;
  uint64_t v3 = 0x7465646279746573ULL ^ k1;

  const uint8_t *end = m + (len & ~((size_t)7));
  int left = (int)(len & 7);

  for (const uint8_t *p = m; p != end; p += 8) {
    uint64_t mi = U8TO64_LE(p);
    v3 ^= mi;
    sipround(&v0, &v1, &v2, &v3);
    sipround(&v0, &v1, &v2, &v3);
    v0 ^= mi;
  }

  uint64_t b = ((uint64_t)len) << 56;
  switch (left) { /* fallthroughs intentional */
  case 7:
    b |= ((uint64_t)m[len - 7]) << 48;
  case 6:
    b |= ((uint64_t)m[len - 6]) << 40;
  case 5:
    b |= ((uint64_t)m[len - 5]) << 32;
  case 4:
    b |= ((uint64_t)m[len - 4]) << 24;
  case 3:
    b |= ((uint64_t)m[len - 3]) << 16;
  case 2:
    b |= ((uint64_t)m[len - 2]) << 8;
  case 1:
    b |= ((uint64_t)m[len - 1]);
  default:
    break;
  }

  v3 ^= b;
  sipround(&v0, &v1, &v2, &v3);
  sipround(&v0, &v1, &v2, &v3);
  v0 ^= b;
  v2 ^= 0xff;
  sipround(&v0, &v1, &v2, &v3);
  sipround(&v0, &v1, &v2, &v3);
  sipround(&v0, &v1, &v2, &v3);
  sipround(&v0, &v1, &v2, &v3);
  uint64_t tag = v0 ^ v1 ^ v2 ^ v3;

  out[0] = (uint8_t)(tag >> 0);
  out[1] = (uint8_t)(tag >> 8);
  out[2] = (uint8_t)(tag >> 16);
  out[3] = (uint8_t)(tag >> 24);
  out[4] = (uint8_t)(tag >> 32);
  out[5] = (uint8_t)(tag >> 40);
  out[6] = (uint8_t)(tag >> 48);
  out[7] = (uint8_t)(tag >> 56);
}
```

## src/siphash.h
```c
#pragma once
#include <stdint.h>
#include <stddef.h>

/* SipHash-2-4, 64-bit tag */
void siphash24(uint8_t tag[8], const uint8_t *msg, size_t msg_len, const uint8_t key[16]);
```
