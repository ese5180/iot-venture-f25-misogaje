## misogate/build_1/Kconfig/Kconfig.modules
```kconfig
menu "memfault-firmware-sdk (/Users/sophiafu/Documents/ESE5180/modules/lib/memfault-firmware-sdk)"
osource "/Users/sophiafu/Documents/ESE5180/modules/lib/memfault-firmware-sdk/ports/zephyr/Kconfig"
config ZEPHYR_MEMFAULT_FIRMWARE_SDK_MODULE
	bool
	default y
endmenu
menu "cmsis (/Users/sophiafu/Documents/ESE5180/modules/hal/cmsis)"
osource "$(ZEPHYR_CMSIS_KCONFIG)"
config ZEPHYR_CMSIS_MODULE
	bool
	default y
endmenu
menu "hal_nordic (/Users/sophiafu/Documents/ESE5180/modules/hal/nordic)"
osource "$(ZEPHYR_HAL_NORDIC_KCONFIG)"
config ZEPHYR_HAL_NORDIC_MODULE
	bool
	default y

config ZEPHYR_HAL_NORDIC_MODULE_BLOBS
	bool
endmenu
menu "mbedtls (/Users/sophiafu/Documents/ESE5180/modules/crypto/mbedtls)"
osource "$(ZEPHYR_MBEDTLS_KCONFIG)"
config ZEPHYR_MBEDTLS_MODULE
	bool
	default y
endmenu
config ZEPHYR_MCUBOOT_MODULE
	bool
	default y
menu "picolibc (/Users/sophiafu/Documents/ESE5180/modules/lib/picolibc)"
osource "/Users/sophiafu/Documents/ESE5180/modules/lib/picolibc/zephyr/Kconfig"
config ZEPHYR_PICOLIBC_MODULE
	bool
	default y
endmenu
```

## misogate/build_1/Kconfig/Kconfig.sysbuild.modules
```kconfig
config ZEPHYR_MEMFAULT_FIRMWARE_SDK_MODULE
   bool
   default y
config ZEPHYR_CMSIS_MODULE
   bool
   default y
config ZEPHYR_HAL_NORDIC_MODULE
   bool
   default y
config ZEPHYR_MBEDTLS_MODULE
   bool
   default y
config ZEPHYR_MCUBOOT_MODULE
   bool
   default y
config ZEPHYR_PICOLIBC_MODULE
   bool
   default y
```

## misogate/build_1/Kconfig/arch/Kconfig
```kconfig
# Load Zephyr Arch Kconfig descriptions.
osource "/Users/sophiafu/Documents/ESE5180/zephyr/arch/rx/Kconfig"
osource "/Users/sophiafu/Documents/ESE5180/zephyr/arch/x86/Kconfig"
osource "/Users/sophiafu/Documents/ESE5180/zephyr/arch/xtensa/Kconfig"
osource "/Users/sophiafu/Documents/ESE5180/zephyr/arch/sparc/Kconfig"
osource "/Users/sophiafu/Documents/ESE5180/zephyr/arch/riscv/Kconfig"
osource "/Users/sophiafu/Documents/ESE5180/zephyr/arch/posix/Kconfig"
osource "/Users/sophiafu/Documents/ESE5180/zephyr/arch/mips/Kconfig"
osource "/Users/sophiafu/Documents/ESE5180/zephyr/arch/arm64/Kconfig"
osource "/Users/sophiafu/Documents/ESE5180/zephyr/arch/arm/Kconfig"
osource "/Users/sophiafu/Documents/ESE5180/zephyr/arch/arc/Kconfig"
```

## misogate/build_1/Kconfig/boards/Kconfig.defconfig
```kconfig
# Load Zephyr board defconfig descriptions.
osource "/Users/sophiafu/Documents/ESE5180/zephyr/boards/nordic/nrf7002dk/Kconfig.defconfig"
```

## misogate/build_1/Kconfig/boards/Kconfig.nrf7002dk
```kconfig
# Load board Kconfig descriptions.
osource "/Users/sophiafu/Documents/ESE5180/zephyr/boards/nordic/nrf7002dk/Kconfig.nrf7002dk"
```

## misogate/build_1/Kconfig/boards/Kconfig.sysbuild
```kconfig
# Load Sysbuild board Kconfig descriptions.
osource "/Users/sophiafu/Documents/ESE5180/zephyr/boards/nordic/nrf7002dk/Kconfig.sysbuild"
```

## west.yml
```yaml
# =============================================================================
# West Manifest for misogate/misonode Project
# =============================================================================
# This manifest sets up the Zephyr workspace with required dependencies.
# For nRF Connect SDK projects, this pulls in Zephyr and Nordic modules.
# =============================================================================

manifest:
  version: "1.0"
  
  # Self reference - this repo is the manifest repository
  self:
    path: .

  remotes:
    - name: zephyrproject-rtos
      url-base: https://github.com/zephyrproject-rtos
    - name: nrfconnect
      url-base: https://github.com/nrfconnect
    - name: memfault
      url-base: https://github.com/memfault

  projects:
    # Zephyr RTOS
    - name: zephyr
      remote: zephyrproject-rtos
      revision: main
      import:
        # Import Zephyr's dependencies (HALs, etc.)
        name-allowlist:
          - cmsis
          - hal_nordic
          - mbedtls
          - mcuboot
          - net-tools
          - picolibc
          - tinycrypt

    # Memfault SDK (as referenced in your misogate/west.yml)
    - name: memfault-firmware-sdk
      remote: memfault
      path: modules/lib/memfault-firmware-sdk
      revision: 1.9.0

  # Group configuration for optional modules
  group-filter:
    - -optional
```
