&arduino_spi {
    status = "okay";
    cs-gpios = <&arduino_header 16 GPIO_ACTIVE_LOW>; /* D10 */
    
    rfm69: rfm69@0 {
        compatible = "semtech,sx1276";
        reg = <0>;
        spi-max-frequency = <1000000>;
        label = "RFM69HCW";
        reset-gpios = <&arduino_header 15 GPIO_ACTIVE_LOW>; /* D9 */
        dio-gpios = <&arduino_header 8 (GPIO_ACTIVE_HIGH | GPIO_PULL_DOWN)>; /* D2 - DIO0 */
    };
};